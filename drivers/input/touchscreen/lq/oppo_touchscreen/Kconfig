## drivers/input/touchscreen/lq/oppo_touchscreen/Kconfig
```kconfig
config TOUCHIRQ_UPDATE_QOS
	default y
	bool "TP TOUCHIRQ_UPDATE enable QOS"
	---help---
	say Y to enable driver for Touchpanel using oppo_touchscreen

config TOUCHPANEL_OPPO
	default y
	bool "TP oppo_touchscreen enable or not for OPPO"
	---help---
	say Y to enable driver for Touchpanel using oppo_touchscreen
	
source "drivers/input/touchscreen/lq/oppo_touchscreen/util_interface/Kconfig"

config TOUCHPANEL_NOVA
	default y
	bool "TP Nova_IC enable or not for OPPO"
	---help---
	say Y to enable driver for Touchpanel using NOVATECK_IC

source "drivers/input/touchscreen/lq/oppo_touchscreen/Novatek/Kconfig"
```

## drivers/input/touchscreen/lq/oppo_touchscreen/Novatek/Kconfig
```kconfig
source "drivers/input/touchscreen/lq/oppo_touchscreen/Novatek/NT36672C_noflash/Kconfig"
```

## drivers/input/touchscreen/lq/oppo_touchscreen/Novatek/NT36672C_noflash/Kconfig
```kconfig
#ifdef VENDOR_EDIT
#Added by Zhouwenping@Bsp.group.Tp for nova nt36672 ic driver

config TOUCHSCREEN_NT36xxx_HOSTDL_SPI
	default y
	bool "TP nova nt36672C IC enable or not for OPPO"
	---help---
	say Y to enable driver for Touchpanel useing nova nt36672c

#endif
```

## drivers/input/touchscreen/lq/oppo_touchscreen/util_interface/Kconfig
```kconfig
#ifdef VENDOR_EDIT
#Added by Tong.han@Bsp.group.Tp for synaptics ic driver

config TOUCHPANEL_OPPO
	default y
	bool "TP oppo_touchscreen "
	---help---
	say Y to enable driver for Touchpanel useing oppo_touchscreen

#endif
```
