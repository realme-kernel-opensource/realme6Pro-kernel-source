/* Copyright (c) 2019, The Linux Foundation. All rights reserved.
 *
 * This program is free software; you can redistribute it and/or modify
 * it under the terms of the GNU General Public License version 2 and
 * only version 2 as published by the Free Software Foundation.
 *
 * This program is distributed in the hope that it will be useful,
 * but WITHOUT ANY WARRANTY; without even the implied warranty of
 * MERCHANTABILITY or FITNESS FOR A PARTICULAR PURPOSE.  See the
 * GNU General Public License for more details.
 */

&mdss_mdp {
	dsi_nt36672c_boe_video: qcom,mdss_dsi_nt36672c_boe_video {
		qcom,mdss-dsi-panel-name =
			"nt36672c fhd plus video mode dsi panel";
		qcom,mdss-dsi-panel-type = "dsi_video_mode";
		qcom,mdss-dsi-virtual-channel-id = <0>;
		qcom,mdss-dsi-stream = <0>;
		qcom,mdss-dsi-bpp = <24>;
		qcom,mdss-dsi-underflow-color = <0xff>;
		qcom,mdss-dsi-border-color = <0>;
		qcom,mdss-dsi-traffic-mode = "non_burst_sync_event";
		qcom,mdss-dsi-bllp-eof-power-mode;
		qcom,mdss-dsi-bllp-power-mode;
		qcom,mdss-dsi-lane-0-state;
		qcom,mdss-dsi-lane-1-state;
		qcom,mdss-dsi-lane-2-state;
		qcom,mdss-dsi-dma-trigger = "trigger_sw";
		qcom,mdss-dsi-mdp-trigger = "none";
		qcom,mdss-dsi-reset-sequence = <1 20>, <0 20>, <1 20>;
		qcom,mdss-pan-physical-width-dimension = <68>;
		qcom,mdss-pan-physical-height-dimension = <152>;
		qcom,mdss-dsi-dma-schedule-line = <5>;

		qcom,mdss-dsi-panel-peak-brightness = <4200000>;
		qcom,mdss-dsi-panel-blackness-level = <3230>;
		qcom,panel-cphy-mode;

		qcom,mdss-dsi-display-timings {
			timing@0{
				qcom,mdss-dsi-panel-width = <1080>;
				qcom,mdss-dsi-panel-height = <2400>;
				qcom,mdss-dsi-h-front-porch = <76>;
				qcom,mdss-dsi-h-back-porch = <56>;
				qcom,mdss-dsi-h-pulse-width = <12>;
				qcom,mdss-dsi-h-sync-skew = <0>;
				qcom,mdss-dsi-v-back-porch = <10>;
				qcom,mdss-dsi-v-front-porch = <54>;
				qcom,mdss-dsi-v-pulse-width = <10>;
				qcom,mdss-dsi-panel-framerate = <90>;
				qcom,mdss-dsi-on-command = [
						29 01 00 00 00 00 02 FF 10
						29 01 00 00 00 00 02 FB 01
						29 01 00 00 00 00 02 B0 00
						29 01 00 00 00 00 02 C0 00       /*VESA off for C-PHY*/
						29 01 00 00 00 00 03 C2 1B A0

						29 01 00 00 00 00 02 FF 25
						29 01 00 00 00 00 02 FB 01
						29 01 00 00 00 00 02 18 20     /*60hz :21 ; 90hz:20*/

						/*#ifdef ODM_LQ_EDIT*/
						/*qujiong@ODM_LQ@BSP.touch,2019/10/30,modified for TP self-test*/
						29 01 00 00 00 00 02 FF F0
						29 01 00 00 00 00 02 FB 01
						29 01 00 00 00 00 02 5A 00
						29 01 00 00 00 00 02 A0 08
						29 01 00 00 00 00 02 FF D0
						29 01 00 00 00 00 02 FB 01
						29 01 00 00 00 00 02 09 AD
						/*endif ODM_LQ_EDIT*/

						29 01 00 00 00 00 02 FF 10
						29 01 00 00 00 00 02 35 00
						05 01 00 00 78 00 02 11 00
						05 01 00 00 14 00 02 29 00
					];
				qcom,mdss-dsi-off-command =[
					05 01 00 00 14 00 02 28 00
					05 01 00 00 78 00 02 10 00
					];
				qcom,mdss-dsi-on-command-state = "dsi_lp_mode";
				qcom,mdss-dsi-off-command-state = "dsi_hs_mode";
			};
		};
	};
};
